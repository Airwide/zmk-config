## config/boards/shields/dactyl_air/Kconfig.defconfig
```kconfig
if SHIELD_DACTYL_AIR_LEFT

    config ZMK_KEYBOARD_NAME
        default "Dactyl Air"

    config ZMK_SPLIT_BLE_ROLE_CENTRAL
        default y
endif

if SHIELD_DACTYL_AIR_RIGHT

    config ZMK_KEYBOARD_NAME
        default "Dactyl Air Right"

endif

if SHIELD_DACTYL_AIR_LEFT || SHIELD_DACTYL_AIR_RIGHT

    config ZMK_SPLIT
        default y

endif
```

## config/boards/shields/dactyl_air/Kconfig.shield
```kconfig
config SHIELD_DACTYL_AIR_LEFT
    def_bool $(shields_list_contains,dactyl_air_left)

config SHIELD_DACTYL_AIR_RIGHT
    def_bool $(shields_list_contains,dactyl_air_right)
```
