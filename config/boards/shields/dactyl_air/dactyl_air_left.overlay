// dactyl_air_left.overlay

#include "dactyl_air.dtsi" 

&kscan0 {
    col-gpios
        = <&gpio0 24 GPIO_ACTIVE_HIGH>
        //, <&gpio1 0  GPIO_ACTIVE_HIGH>
        , <&gpio0 22 GPIO_ACTIVE_HIGH> // P1.00 pad broken on my board. Used P0.22 instead.
        , <&gpio0 11 GPIO_ACTIVE_HIGH>
        , <&gpio1 4  GPIO_ACTIVE_HIGH>
        , <&gpio1 6  GPIO_ACTIVE_HIGH>
        ;
};